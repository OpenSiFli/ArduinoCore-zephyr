## west.yml
```yaml
# Copyright (c) 2022 Dhruva Gole <goledhruva@gmail.com>
# SPDX-License-Identifier: Apache-2.0

# NOTE: This is created to be used for CI/CD workflow. So use it only
# if you are in the zephyrproject directory or else things may break.

manifest:
  self:
    path: modules/lib/ArduinoCore-zephyr

  remotes:
    - name: zephyrproject-rtos
      url-base: https://github.com/zephyrproject-rtos
    - name: arduino
      url-base: https://github.com/arduino
    - name: OpenSiFli
      url-base: https://github.com/OpenSiFli
    - name: facchinm
      url-base: https://github.com/facchinm
    - name: pillo79
      url-base: https://github.com/pillo79

  projects:
    - name: zephyr
      remote: OpenSiFli
      repo-path: zephyr-downstream
      revision: 7c31bd523fd9effd599e573da1258e5a01d86755
      import:
        name-allowlist:
          - cmsis
          - cmsis_6
          - littlefs
          - tinycrypt
          - mbedtls
          - segger
          - thrift
          - mcuboot
          - nanopb
          - lvgl
          - fatfs
          - hal_sifli
        path-allowlist:
          - modules/hal/*

        # The actual list of enabled HALs is set by extra/bootstrap.sh via
        # the 'manifest.project-filter' config. Enable all Zephyr HALs with:
        #
        #   west config -d manifest.project-filter

    - name: ArduinoCore-API
      path: modules/lib/ArduinoCore-API
      revision: master
      url: https://github.com/arduino/ArduinoCore-API
```
